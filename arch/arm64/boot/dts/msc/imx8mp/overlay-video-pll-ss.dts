/*
 * Copyright (C) 2022 Avnet Embedded GmbH
 *
 * This program is free software; you can redistribute it and/or
 * modify it under the terms of the GNU General Public License as
 * published by the Free Software Foundation version 2.
 *
 * This program is distributed "as is" WITHOUT ANY WARRANTY of any
 * kind, whether express or implied; without even the implied warranty
 * of MERCHANTABILITY or FITNESS FOR A PARTICULAR PURPOSE.  See the
 * GNU General Public License for more details.
 */

/dts-v1/;
/plugin/;

#include <dt-bindings/clock/imx8mp-clock.h>

/ {
	fragment@9000 {
		target = <&anatop>;
		__overlay__ {
			video-pll1-ss,enable;
			video-pll1-ss,ffin_MHz = <24>;
			video-pll1-ss,mf_kHz = <30>;
			video-pll1-ss,mr = <VIDEO_PLL1_SPREAD_DEPTH_1_0_PERCENT>;
		};
	};
};
