/** @file      msc-sm2s-imx8-baseboard-none.dtsi

    @copyright Copyright (C) 2020 by MSC Technologies GmbH
    SPDX-License Identifier: GPL-2.0-or-later

    @author    Markus Pietrek

    @details   Provides baseboard mappings that are merged at runtime with the CPU device tree.
*/

/dts-v1/;
/plugin/;

#include <dt-bindings/gpio/gpio.h>

/ {
	fragment@0 {
		target-path = "/";

		__overlay__ {
			baseboard-dtb = "none"; /* just informal */
		};
	};

	fragment@4 {
		target-path = "/";
		__overlay__ {
			user_gpios {
				compatible = "msc,user-gpios";
				pinctrl-names = "default";
				pinctrl-0 =
					<&pinctrl_smarc_gpio_gpio5_gpio>, // FAN is not connected, so configure pins as GPIOs even when we don't connect them to feature connector
					<&pinctrl_smarc_gpio_gpio6_gpio>; // should be couting pulses, but pins is neither connected to GPT nor TPM
					// <&pinctrl_smarc_gpio>; already done in hog grp to be earlier - needed for DSI displays


				GPIO0-gpios = <&lsio_gpio0 0 0>;
				GPIO1-gpios = <&lsio_gpio0 2 0>;
				GPIO2-gpios = <&lsio_gpio0 1 0>;
				GPIO3-gpios = <&lsio_gpio0 5 0>;
				GPIO4-gpios = <&lsio_gpio4 2 0>;
				GPIO5-gpios = <&lsio_gpio0 19 0>;
				GPIO6-gpios = <&lsio_gpio0 16 0>;
				GPIO7-gpios = <&lsio_gpio4 1 0>;
#if MODULE_MES_REVISION != 20
				GPIO8-gpios = <&lsio_gpio2 27 0>;
				GPIO9-gpios = <&lsio_gpio1 18 0>;
				GPIO10-gpios = <&lsio_gpio2 29 0>;
				GPIO11-gpios = <&lsio_gpio1 17 0>;

				GPIO12-gpios = <&lsio_gpio1 13 0>;
				GPIO13-gpios = <&lsio_gpio1 7 0>;
#else
				GPIO8-gpios = <&lsio_gpio0 30 0>;
				GPIO9-gpios = <&lsio_gpio0 31 0>;
				GPIO10-gpios = <&lsio_gpio1 0 0>;
				GPIO11-gpios = <&lsio_gpio1 1 0>;
#endif
			};
		};
	};
};
