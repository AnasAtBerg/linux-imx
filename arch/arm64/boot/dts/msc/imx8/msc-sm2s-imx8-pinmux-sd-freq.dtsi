/* adjust these whenever pinctrl_emmc or pinctrl_sdio in msc-sm2s-imx8-pinmux.dtsi changes */

		pinctrl_emmc_100mhz: emmcgrp100mhz {                            /*!< Function assigned for the core: Cortex-A53[ca53_0] */
            fsl,pins = <
			SC_P_EMMC0_CLK_CONN_EMMC0_CLK		0x06000040
			SC_P_EMMC0_CMD_CONN_EMMC0_CMD		0x00000020
			SC_P_EMMC0_DATA0_CONN_EMMC0_DATA0	0x00000020
			SC_P_EMMC0_DATA1_CONN_EMMC0_DATA1	0x00000020
			SC_P_EMMC0_DATA2_CONN_EMMC0_DATA2	0x00000020
			SC_P_EMMC0_DATA3_CONN_EMMC0_DATA3	0x00000020
			SC_P_EMMC0_DATA4_CONN_EMMC0_DATA4	0x00000020
			SC_P_EMMC0_DATA5_CONN_EMMC0_DATA5	0x00000020
			SC_P_EMMC0_DATA6_CONN_EMMC0_DATA6	0x00000020
			SC_P_EMMC0_DATA7_CONN_EMMC0_DATA7	0x00000020
			SC_P_EMMC0_STROBE_CONN_EMMC0_STROBE	0x00000040
			SC_P_EMMC0_RESET_B_CONN_EMMC0_RESET_B	0x00000020
            >;
        };

		pinctrl_emmc_200mhz: emmcgrp200mhz {                            /*!< Function assigned for the core: Cortex-A53[ca53_0] */
            fsl,pins = <
			SC_P_EMMC0_CLK_CONN_EMMC0_CLK		0x06000040
			SC_P_EMMC0_CMD_CONN_EMMC0_CMD		0x00000020
			SC_P_EMMC0_DATA0_CONN_EMMC0_DATA0	0x00000020
			SC_P_EMMC0_DATA1_CONN_EMMC0_DATA1	0x00000020
			SC_P_EMMC0_DATA2_CONN_EMMC0_DATA2	0x00000020
			SC_P_EMMC0_DATA3_CONN_EMMC0_DATA3	0x00000020
			SC_P_EMMC0_DATA4_CONN_EMMC0_DATA4	0x00000020
			SC_P_EMMC0_DATA5_CONN_EMMC0_DATA5	0x00000020
			SC_P_EMMC0_DATA6_CONN_EMMC0_DATA6	0x00000020
			SC_P_EMMC0_DATA7_CONN_EMMC0_DATA7	0x00000020
			SC_P_EMMC0_STROBE_CONN_EMMC0_STROBE	0x00000040
			SC_P_EMMC0_RESET_B_CONN_EMMC0_RESET_B	0x00000020
            >;
        };

		pinctrl_sdio_100mhz: sdiogrp100mhz {
            fsl,pins = <
			SC_P_USDHC1_CLK_CONN_USDHC1_CLK		0x06000040
			SC_P_USDHC1_CMD_CONN_USDHC1_CMD		0x00000020
			SC_P_USDHC1_DATA0_CONN_USDHC1_DATA0	0x00000020
			SC_P_USDHC1_DATA1_CONN_USDHC1_DATA1	0x00000020
			SC_P_USDHC1_DATA2_CONN_USDHC1_DATA2	0x00000020
			SC_P_USDHC1_DATA3_CONN_USDHC1_DATA3	0x00000020
			SC_P_USDHC1_VSELECT_CONN_USDHC1_VSELECT	0x00000020
            >;
        };

		pinctrl_sdio_200mhz: sdiogrp200mhz {
            fsl,pins = <
			SC_P_USDHC1_CLK_CONN_USDHC1_CLK		0x06000040
			SC_P_USDHC1_CMD_CONN_USDHC1_CMD		0x00000020
			SC_P_USDHC1_DATA0_CONN_USDHC1_DATA0	0x00000020
			SC_P_USDHC1_DATA1_CONN_USDHC1_DATA1	0x00000020
			SC_P_USDHC1_DATA2_CONN_USDHC1_DATA2	0x00000020
			SC_P_USDHC1_DATA3_CONN_USDHC1_DATA3	0x00000020
			SC_P_USDHC1_VSELECT_CONN_USDHC1_VSELECT	0x00000020
            >;
        };
