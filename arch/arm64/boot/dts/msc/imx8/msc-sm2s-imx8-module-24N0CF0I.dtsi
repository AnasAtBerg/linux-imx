/** @file      msc-sm2s-imx8-module-24N0CF0I.dtsi

    @copyright Copyright (C) 2020 by MSC Technologies GmbH
			   Copyright 2017-2018 NXP
    SPDX-License Identifier: GPL-2.0-or-later

    @author    Markus Pietrek
*/

/* 24N0CF0I feature key decoded:
   * 2: DRAM: 4GB
   * 4: eMMC: 16GB
   * N: SATA Size: no SATA SSD populated
   * 0: Memory: no (ECC, eMMC/SATA SLC, SD Card socket) support
   * C: Displays: DSI, HDMI
   * F: Peripheral: dual gigabit ethernet, WLAN, dual can, USB 2.0 1x, USB 2.0 Device 1x
   * 0: Security: no TPM
   * I: Temperature range: industrial (-40°C...+85°C)
*/

// define module features
#define HAS_QSPI
#define HAS_WIFI
#define HAS_ETH_DUAL
#define HAS_CAN_DUAL
#define HAS_USB2
#define HAS_USB2_DEV

#include "msc-sm2s-imx8-module.dtsi"
