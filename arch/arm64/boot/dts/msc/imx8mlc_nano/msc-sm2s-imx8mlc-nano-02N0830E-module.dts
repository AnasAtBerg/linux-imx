/*
 * Copyright (C) 2022 Avnet Embedded GmbH
 *
 * This program is free software; you can redistribute it and/or
 * modify it under the terms of the GNU General Public License as
 * published by the Free Software Foundation version 2.
 *
 * This program is distributed "as is" WITHOUT ANY WARRANTY of any
 * kind, whether express or implied; without even the implied warranty
 * of MERCHANTABILITY or FITNESS FOR A PARTICULAR PURPOSE.  See the
 * GNU General Public License for more details.
 */

/dts-v1/;

#include "msc-sm2s-imx8mlc-nano-module.dtsi"
#include "industrial-temp-grade.dtsi"

/ {
	memory@40000000 {
		reg = <0x0 0x40000000 0 0x40000000>; /* 1GiB DDR4 */
	};
};